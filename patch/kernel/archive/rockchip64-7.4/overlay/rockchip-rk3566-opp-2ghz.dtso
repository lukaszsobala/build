// SPDX-License-Identifier: (GPL-2.0+ OR MIT)
/*
 * Add a 1992 MHz CPU OPP at 1.2 V for RK3566.
 * The kernel ignores the OPP if the board limits vdd_cpu below 1.2 V.
 */
/dts-v1/;
/plugin/;

/ {
	fragment@0 {
		target = <&cpu0_opp_table>;

		__overlay__ {
			opp-1992000000 {
				opp-hz = /bits/ 64 <1992000000>;
				opp-microvolt = <1200000 1200000 1200000>;
				clock-latency-ns = <40000>;
			};
		};
	};
};
